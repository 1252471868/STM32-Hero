## board/Kconfig
```kconfig
menu "Hardware Drivers Config"

config SOC_STM32F427VI
    bool
    select SOC_SERIES_STM32F4
    select RT_USING_COMPONENTS_INIT
    select RT_USING_USER_MAIN
    default y

menu "Onboard Peripheral Drivers"

    config CORE_USING_MONITOR
        bool "Enable software wdg"
        select CORE_USING_BUZZER
        select CORE_USING_RGB_LIGHT
        select BSP_USING_WDT
        default n

    config CORE_USING_BUZZER
        bool "Enable buzzer (pwm2 ch3)"
        select BSP_USING_PWM
        select BSP_USING_PWM2
        select BSP_USING_PWM2_CH3
        default n

    config CORE_USING_RGB_LIGHT
        bool "Enable RGB light (pwm5 ch3  pwm9 ch1 ch2)"
        select BSP_USING_PWM
        select BSP_USING_PWM5
        select BSP_USING_PWM5_CH3
        select BSP_USING_PWM9
        select BSP_USING_PWM9_CH1
        select BSP_USING_PWM9_CH2
        default n

endmenu

menu "On-chip Peripheral Drivers"

    config BSP_USING_GPIO
        bool "Enable GPIO"
        select RT_USING_PIN
        default y

    menuconfig BSP_USING_UART
        bool "Enable UART"
        default y
        select RT_USING_SERIAL
        if BSP_USING_UART
            config BSP_USING_UART1
                bool "Enable UART1"
                default n

            config BSP_UART1_RX_USING_DMA
                bool "Enable UART1 RX DMA"
                depends on BSP_USING_UART1 && RT_SERIAL_USING_DMA
                default n

            config BSP_USING_UART3
                bool "Enable UART3"
                default n

            config BSP_UART3_RX_USING_DMA
                bool "Enable UART3 RX DMA"
                depends on BSP_USING_UART3 && RT_SERIAL_USING_DMA
                default n

            config BSP_USING_UART6
                bool "Enable UART6"
                default n

            config BSP_UART6_RX_USING_DMA
                bool "Enable UART6 RX DMA"
                depends on BSP_USING_UART6 && RT_SERIAL_USING_DMA
                default n

            config BSP_USING_UART7
                bool "Enable UART7"
                default n

            config BSP_UART7_RX_USING_DMA
                bool "Enable UART7 RX DMA"
                depends on BSP_USING_UART7 && RT_SERIAL_USING_DMA
                default n

            config BSP_USING_UART8
                bool "Enable UART8"
                default y

            config BSP_UART8_RX_USING_DMA
                bool "Enable UART8 RX DMA"
                depends on BSP_USING_UART8 && RT_SERIAL_USING_DMA
                default n
        endif

    menuconfig BSP_USING_PWM
        bool "Enable pwm"
        default n
        select RT_USING_PWM
        if BSP_USING_PWM

        menuconfig BSP_USING_PWM1
            bool "Enable timer1 output pwm"
            default n
            if BSP_USING_PWM1
                config BSP_USING_PWM1_CH1
                    bool "Enable PWM1 channel1 (PA8)"
                    default n
                config BSP_USING_PWM1_CH2
                    bool "Enable PWM1 channel2 (PA9)"
                    default n
            endif

        menuconfig BSP_USING_PWM2
            bool "Enable timer2 output pwm"
            default n
            if BSP_USING_PWM2
                config BSP_USING_PWM2_CH3
                    bool "Enable PWM2 channel3 (PB10)"
                    default n
            endif

        menuconfig BSP_USING_PWM4
            bool "Enable timer4 output pwm"
            default n
            if BSP_USING_PWM4
                config BSP_USING_PWM4_CH1
                    bool "Enable PWM4 channel1 (PD12)"
                    default n
                config BSP_USING_PWM4_CH2
                    bool "Enable PWM4 channel2 (PD13)"
                    default n
                config BSP_USING_PWM4_CH3
                    bool "Enable PWM4 channel3 (PB8)"
                    default n
                config BSP_USING_PWM4_CH4
                    bool "Enable PWM4 channel4 (PB9)"
                    default n
            endif

        menuconfig BSP_USING_PWM5
            bool "Enable timer5 output pwm"
            default n
            if BSP_USING_PWM5
                config BSP_USING_PWM5_CH3
                    bool "Enable PWM5 channel3 (PA2)"
                    default n
            endif

        menuconfig BSP_USING_PWM8
            bool "Enable timer8 output pwm"
            default n
            if BSP_USING_PWM8
                config BSP_USING_PWM8_CH3
                    bool "Enable PWM8 channel3 (PC8)"
                    default n
                config BSP_USING_PWM8_CH4
                    bool "Enable PWM8 channel4 (PC9)"
                    default n
            endif

        menuconfig BSP_USING_PWM9
            bool "Enable timer9 output pwm"
            default n
            if BSP_USING_PWM9
                config BSP_USING_PWM9_CH1
                    bool "Enable PWM9 channel1 (PE5)"
                    default n
                config BSP_USING_PWM9_CH2
                    bool "Enable PWM9 channel2 (PE6)"
                    default n
            endif

        endif

    menuconfig BSP_USING_ADC
        bool "Enable ADC"
        default n
        select RT_USING_ADC
        if BSP_USING_ADC
            config BSP_USING_ADC1
                bool "Enable ADC1"
                default n
        endif

    menuconfig BSP_USING_CAN
        bool "Enable CAN"
        default n
        select RT_USING_CAN
        if BSP_USING_CAN
            config BSP_USING_CAN1
                bool "Enable CAN1"
                default n

            config BSP_USING_CAN2
                bool "Enable CAN2"
                default n
        endif

    menuconfig BSP_USING_SPI
        bool "Enable SPI BUS"
        default n
        select RT_USING_SPI
        if BSP_USING_SPI
            config BSP_USING_SPI3
                bool "Enable SPI3 BUS"
                default n

            config BSP_SPI3_TX_USING_DMA
                bool "Enable SPI3 TX DMA"
                depends on BSP_USING_SPI3
                default n

            config BSP_SPI3_RX_USING_DMA
                bool "Enable SPI3 RX DMA"
                depends on BSP_USING_SPI3
                select BSP_SPI3_TX_USING_DMA
                default n

            config BSP_USING_SPI4
                bool "Enable SPI4 BUS"
                default n

            config BSP_SPI4_TX_USING_DMA
                bool "Enable SPI4 TX DMA"
                depends on BSP_USING_SPI4
                default n

            config BSP_SPI4_RX_USING_DMA
                bool "Enable SPI4 RX DMA"
                depends on BSP_USING_SPI4
                select BSP_SPI4_TX_USING_DMA
                default n
        endif

    menuconfig BSP_USING_I2C1
        bool "Enable I2C1 BUS (software simulation)"
        default n
        select RT_USING_I2C
        select RT_USING_I2C_BITOPS
        select RT_USING_PIN
        if BSP_USING_I2C1
            config BSP_I2C1_SCL_PIN
                int "i2c1 scl pin number"
                range 1 216
                default 15
            config BSP_I2C1_SDA_PIN
                int "I2C1 sda pin number"
                range 1 216
                default 16
        endif

    config BSP_USING_WDT
        bool "Enable Watchdog Timer"
        select RT_USING_WDT
        default n

endmenu

menu "Board extended module Drivers"

endmenu

endmenu
```
